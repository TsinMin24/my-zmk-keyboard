/ {
    chosen {
        zmk,kscan = &kscan;
    };

    kscan: kscan_0 {
        compatible = "zmk,kscan-gpio-direct";
        label = "KSCAN";
        size = <4>;
        gpios
            = <&gpio0 1  (GPIO_ACTIVE_LOW | GPIO_PULL_UP)>
            , <&gpio0 3  (GPIO_ACTIVE_LOW | GPIO_PULL_UP)>
            , <&gpio0 2  (GPIO_ACTIVE_LOW | GPIO_PULL_UP)>
            , <&gpio0 6  (GPIO_ACTIVE_LOW | GPIO_PULL_UP)>
            ;
    };
};
